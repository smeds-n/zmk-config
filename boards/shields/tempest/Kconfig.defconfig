## boards/shields/tempest/Kconfig.defconfig
```kconfig
if SHIELD_TEMPEST_LEFT

# Name must be less than 16 characters long!
config ZMK_KEYBOARD_NAME
    default "Tempest"

config ZMK_SPLIT_ROLE_CENTRAL
    default y

endif

if SHIELD_TEMPEST_LEFT || SHIELD_TEMPEST_RIGHT

config ZMK_SPLIT
    default y

endif
```

## boards/shields/tempest/Kconfig.shield
```kconfig
# No whitespace after the comma or in your part name!
config SHIELD_TEMPEST_LEFT
    def_bool $(shields_list_contains,tempest_left)

# No whitespace after the comma or in your part name!
config SHIELD_TEMPEST_RIGHT
    def_bool $(shields_list_contains,tempest_right)
```
